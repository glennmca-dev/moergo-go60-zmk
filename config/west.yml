## config/west.yml
```yaml
manifest:
  remotes:
    - name: moergo
      url-base: https://github.com/moergo-sc
  projects:
    - name: zmk
      remote: moergo
      revision: main
      import: app/west.yml
  self:
    path: config
```
